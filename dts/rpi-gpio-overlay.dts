/dts-v1/;
/plugin/;

/ {
    compatible = "raspberrypi,4-model-b", "brcm,bcm2711";

    fragment@0 {
        target-path = "/";

        __overlay__ {
            /* Deliberately different from the driver name: OF match is used. */
            rpi-gpio-lab {
                compatible = "heichi,rpi-gpio";
                status = "okay";
            };
        };
    };
};
